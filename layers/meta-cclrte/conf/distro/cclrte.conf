## layers/meta-cclrte/conf/distro/cclrte.conf
```bitbake
# CODESYS Control Linux RTE — Yocto distribution
require conf/distro/poky.conf

DISTRO        = "cclrte"
DISTRO_NAME   = "CODESYS Control Linux RTE"
DISTRO_VERSION = "1.0"
DISTRO_CODENAME = "scarthgap"
MAINTAINER    = "cclrte"

DISTRO_FEATURES:append = " systemd wifi bluetooth ext2 pci usb preempt-rt"
DISTRO_FEATURES_BACKFILL_CONSIDERED:append = " sysvinit"

VIRTUAL-RUNTIME_init_manager = "systemd"
VIRTUAL-RUNTIME_initscripts  = "systemd-compat-units"
INIT_MANAGER = "systemd"

# GNU libstdc++ required by CODESYS runtime shared libraries
TC_CXX_RUNTIME = "gnu"

SDKIMAGE_FEATURES = "dev-pkgs dbg-pkgs src-pkgs"
IMAGE_LINGUAS = "en-us"

# rt-setup applies CPU affinity and sysctl tuning before CODESYS starts
DISTRO_EXTRA_RDEPENDS += "rt-setup"
```

## layers/meta-cclrte/conf/layer.conf
```bitbake
# meta-cclrte — CODESYS Control Linux RTE Yocto layer

BBPATH .= ":${LAYERDIR}"

BBFILES += "${LAYERDIR}/recipes-*/*/*.bb \
            ${LAYERDIR}/recipes-*/*/*.bbappend"

BBFILE_COLLECTIONS += "meta-cclrte"
BBFILE_PATTERN_meta-cclrte = "^${LAYERDIR}/"
# Priority 10 overrides meta-raspberrypi (7) and meta-oe (6)
BBFILE_PRIORITY_meta-cclrte = "10"

LAYERDEPENDS_meta-cclrte = "core openembedded-layer networking-layer meta-python"
LAYERSERIES_COMPAT_meta-cclrte = "scarthgap"
```

## layers/meta-cclrte/conf/machine/rpi5-cclrte-xenomai.conf
```bitbake
#@TYPE: Machine
#@NAME: Raspberry Pi 5 — CODESYS Control Linux RTE (Xenomai Cobalt)
#@DESCRIPTION: RPi5 2GB (BCM2712 / Cortex-A76) with Xenomai Cobalt dual-kernel.
#   Worst-case latency target: 5-20 µs (BCM2712 is newer; characterise with cyclictest).
#   Use when PREEMPT_RT worst-case > 100 µs or cycle time < 500 µs needed.
#
#   PREREQUISITE: Dovetail patches for kernel 6.6 + BCM2712 must be placed in
#   recipes-kernel/linux/files/patches/ before building.
#   Upstream source: https://source.denx.de/Xenomai/linux-dovetail
#   Target branch: v6.6.y/dovetail (verify against Xenomai 3.3+ release notes)
#
#   CPU2 → EtherCAT master (Cobalt domain, SCHED_FIFO 90)  [isolated]
#   CPU3 → CODESYS scan cycle (Cobalt domain, SCHED_FIFO 80) [isolated]
#   CPU0,1 → Linux OS, WebUI, SSH, MQTT, OPC-UA

require conf/machine/rpi5-cclrte.conf

PREFERRED_PROVIDER_virtual/kernel = "linux-raspberrypi"

# Remove PREEMPT_RT-specific cmdline params that conflict with Cobalt
CMDLINE:remove = "preempt=full"

# xenomai.supported_cpus=0xC : bitmask 0xC = CPUs 2 and 3 (Cobalt domain)
# NOTE: xenomai.smi=disabled is x86-only (SMI does not exist on ARM) — NOT used here
# pcie_aspm=off        : disable PCIe Active State Power Management — prevents
#                        power-state-change latency spikes on the EtherCAT NIC
# pcie_port_pm=off     : disable PCIe port power management for same reason
CMDLINE:append = " xenomai.supported_cpus=0xC isolcpus=2,3 nohz_full=2,3 pcie_aspm=off pcie_port_pm=off"

# PCIe — Waveshare RTL8111H (HAT+ FPC) appended to base RPI_EXTRA_CONFIG
RPI_EXTRA_CONFIG:append = "dtparam=pciex1=on\ndtparam=pciex1_gen=2\n"

IMAGE_FSTYPES = "rpi-sdimg"
```

## layers/meta-cclrte/conf/machine/rpi5-cclrte.conf
```bitbake
#@TYPE: Machine
#@NAME: Raspberry Pi 5 — CODESYS Control Linux RTE (PREEMPT_RT)
#@DESCRIPTION: RPi5 64-bit (BCM2712 / Cortex-A76) tuned for PREEMPT_RT motion control.
#   2 GB RAM variant — build threads capped conservatively.
#   CPU2 → EtherCAT master (SCHED_FIFO 90)  [isolated]
#   CPU3 → CODESYS scan cycle (SCHED_FIFO 80) [isolated]
#   CPU0,1 → Linux OS, WebUI, SSH, MQTT, OPC-UA

require conf/machine/raspberrypi5.conf

PREFERRED_PROVIDER_virtual/kernel = "linux-raspberrypi"
# Map to bcm2712_defconfig — linux-raspberrypi.inc keys KBUILD_DEFCONFIG
# by exact machine name; our custom name doesn't match 'raspberrypi5'
KBUILD_DEFCONFIG = "bcm2712_defconfig"
LINUX_VERSION_EXTENSION = "-cclrte-rt"
MACHINE_EXTRA_RRECOMMENDS += "kernel-modules"
MACHINE_FEATURES:append = " rtc"

# isolcpus=2,3     : reserve CPUs 2,3 exclusively for RT tasks
# nohz_full=2,3    : tickless on isolated CPUs
# rcu_nocbs=2,3    : RCU callbacks off isolated CPUs
# threadirqs       : all IRQ handlers into preemptable kernel threads
# preempt=full     : full kernel preemption
# nosoftlockup     : suppress false-positive warnings on loaded RT cores
# net.ifnames=0    : disable predictable interface names (forces eth0 on RPi5 instead of end0)
CMDLINE:append = " isolcpus=2,3 nohz_full=2,3 rcu_nocbs=2,3 threadirqs preempt=full nosoftlockup net.ifnames=0"

GPU_MEM        = "16"
ENABLE_UART    = "1"
ENABLE_SPI_BUS = "1"
ENABLE_I2C     = "1"

# RPi5 (BCM2712) firmware tuning notes:
#   force_turbo=1        : lock at base arm_freq (2400 MHz), eliminates DVFS latency spikes
#                          NOTE: arm_boost=1 is intentionally absent — it raises the target
#                          to 3.0 GHz which causes thermal issues with force_turbo on RPi5 2GB
#   disable_splash=1     : faster boot
#   dtoverlay=disable-bt : free primary UART for RS-485/Modbus (UART0 = /dev/ttyAMA0)
#   dtparam=watchdog=on  : enable RP1/BCM2712 hardware watchdog
RPI_EXTRA_CONFIG = "force_turbo=1\ndisable_splash=1\ndtoverlay=disable-bt\ndtparam=watchdog=on\n"

IMAGE_FSTYPES = "rpi-sdimg wic.bz2"

# Ensure vfat boot partition label is 11 chars or less to prevent mkfs.vfat errors
BOOTDD_VOLUME_ID = "cclrt-boot"
```
